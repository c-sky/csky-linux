## Documentation/devicetree/bindings/csky/cpus.txt
```
==================
C-SKY CPU Bindings
==================

The device tree allows to describe the layout of CPUs in a system through
the "cpus" node, which in turn contains a number of subnodes (ie "cpu")
defining properties for every cpu.

Only SMP system need to care about the cpus node and single processor
needn't define cpus node at all.

=====================================
cpus and cpu node bindings definition
=====================================

- cpus node

        Description: Container of cpu nodes

        The node name must be "cpus".

        A cpus node must define the following properties:

        - #address-cells
                Usage: required
                Value type: <u32>
                Definition: must be set to 1
        - #size-cells
                Usage: required
                Value type: <u32>
                Definition: must be set to 0

- cpu node

        Description: Describes one of SMP cores

        PROPERTIES

        - device_type
                Usage: required
                Value type: <string>
                Definition: must be "cpu"
        - reg
                Usage: required
                Value type: <u32>
                Definition: CPU index
        - status:
                Usage: required
                Value type: <string>
                Definition: "ok"       means enable  the cpu-core
                            "disabled" means disable the cpu-core

Example:
--------

	cpus {
		#address-cells = <1>;
		#size-cells = <0>;
		cpu@0 {
			device_type = "cpu";
			reg = <0>;
			status = "ok";
		};

		cpu@1 {
			device_type = "cpu";
			reg = <1>;
			status = "ok";
		};
	};
```

## Documentation/devicetree/bindings/interrupt-controller/csky,apb-intc.txt
```
==============================
C-SKY APB Interrupt Controller
==============================

C-SKY APB Interrupt Controller is a simple soc interrupt controller
on the apb bus and we only use it as root irq controller.

 - csky,apb-intc is used in a lot of csky fpgas and socs, it support 64 irq nums.
 - csky,dual-apb-intc consists of 2 apb-intc and 128 irq nums supported.
 - csky,gx6605s-intc is gx6605s soc internal irq interrupt controller, 64 irq nums.

=============================
intc node bindings definition
=============================

        Description: Describes APB interrupt controller

        PROPERTIES

        - compatible
                Usage: required
                Value type: <string>
                Definition: must be "csky,apb-intc"
				    "csky,dual-apb-intc"
				    "csky,gx6605s-intc"
        - interrupt-cells
                Usage: required
                Value type: <u32>
                Definition: must be <1>
	- reg
		Usage: required
		Value type: <u32 u32>
                Definition: <phyaddr size> in soc from cpu view
        - interrupt-controller:
                Usage: required

Examples:
---------

	intc: interrupt-controller {
		compatible = "csky,apb-intc";
		#interrupt-cells = <1>;
		reg = <0x00500000 0x400>;
		interrupt-controller;
	};
```

## Kconfig.addons
```kconfig
config SYNOP_MAC
	tristate "gx synop_mac"

source "addons/irr/Kconfig"

source "addons/gxav/Kconfig"
```

## arch/csky/Kconfig
```kconfig
config CSKY
	bool
	default y
	select ARCH_USE_BUILTIN_BSWAP
	select COMMON_CLK
	select CLKSRC_MMIO
	select CLKSRC_OF
	select IRQ_DOMAIN
	select HANDLE_DOMAIN_IRQ
	select DW_APB_TIMER_OF
	select GENERIC_ATOMIC64
	select GENERIC_CLOCKEVENTS
	select GENERIC_CPU_DEVICES
	select GENERIC_IRQ_CHIP
	select GENERIC_IRQ_PROBE
	select GENERIC_IRQ_SHOW
	select GENERIC_SCHED_CLOCK
	select GENERIC_SMP_IDLE_THREAD
	select HAVE_ARCH_TRACEHOOK
	select HAVE_GENERIC_DMA_COHERENT
	select HAVE_KERNEL_GZIP
	select HAVE_KERNEL_LZO
	select HAVE_KERNEL_LZMA
	select HAVE_PERF_EVENTS
	select HAVE_C_RECORDMCOUNT
	select HAVE_KPROBES
	select HAVE_KRETPROBES
	select HAVE_DMA_API_DEBUG
	select HAVE_MEMBLOCK
	select MAY_HAVE_SPARSE_IRQ
	select MODULES_USE_ELF_RELA if MODULES
	select NO_BOOTMEM
	select OF
	select OF_EARLY_FLATTREE
	select OF_RESERVED_MEM
	select PERF_USE_VMALLOC
	select RTC_LIB
	select TIMER_OF
	select USB_ARCH_HAS_EHCI
	select USB_ARCH_HAS_OHCI

config CPU_HAS_CACHEV2
	bool

config CPU_HAS_HILO
	bool

config CPU_HAS_TLBI
	bool

config CPU_HAS_LDSTEX
	bool
	help
	  For SMP cpu need "ldex&stex" instrcutions to keep atomic.

config CPU_NEED_TLBSYNC
	bool

config CPU_NEED_SOFTALIGN
	bool

config CPU_NO_USER_BKPT
	bool
	help
	  For abiv2 we couldn't use "trap 1" as user space bkpt in gdbserver, because
	  abiv2 is 16/32bit instruction set and "trap 1" is 32bit.
	  So we need a 16bit instruction as user space bkpt, and it will cause a illegal
	  instruction exception.
	  In kernel we parse the *regs->pc to determine wether send SIGTRAP or not.

config GENERIC_CALIBRATE_DELAY
	bool
	default y

config HZ
	int
	default 100

config GENERIC_CSUM
	bool
	default y

config GENERIC_HWEIGHT
	bool
	default y

config MMU
	bool
	default y

config RWSEM_GENERIC_SPINLOCK
	bool
	default y

config TIME_LOW_RES
	bool
	default y

config TRACE_IRQFLAGS_SUPPORT
	bool
	default y

source "init/Kconfig"

source "kernel/Kconfig.freezer"

menu "Processor type and features"

comment "Processor type"

choice
	prompt "CPU MODEL"
	default CPU_CK610

config CPU_CK610
	bool "CSKY CPU ck610"
	select CPU_NEED_TLBSYNC
	select CPU_NEED_SOFTALIGN
	select CPU_NO_USER_BKPT

config CPU_CK810
	bool "CSKY CPU ck810"
	select CPU_HAS_HILO
	select CPU_NEED_TLBSYNC

config CPU_CK807
	bool "CSKY CPU ck807"
	select CPU_HAS_HILO

config CPU_CK860
	bool "CSKY CPU ck860"
	select CPU_HAS_TLBI
	select CPU_HAS_CACHEV2
	select CPU_HAS_LDSTEX
endchoice

config CPU_TLB_SIZE
	int
	default "128"	if(CPU_CK610 || CPU_CK807 || CPU_CK810)
	default "1024"	if(CPU_CK860)

config CPU_ASID_BITS
	int
	default "8"	if(CPU_CK610 || CPU_CK807 || CPU_CK810)
	default "12"	if(CPU_CK860)

config L1_CACHE_SHIFT
	int
	default "4"	if(CPU_CK610)
	default "5"	if(CPU_CK807 || CPU_CK810)
	default "6"	if(CPU_CK860)

config HIGHMEM
	bool "High Memory Support"
	depends on !CPU_CK610
	default y

menuconfig CPU_HAS_FPU
	bool "CPU has FPU coprocessor"
	depends on CPU_CK807 || CPU_CK810 || CPU_CK860

menuconfig CPU_HAS_TEE
	bool "CPU has Trusted Execution Environment"
	depends on CPU_CK810

config SMP
	bool "Symmetric Multi-Processing (SMP) support for C-SKY"
	depends on CPU_CK860
	default n

config NR_CPUS
	int "Maximum number of CPUs (2-32)"
	range 2 32
	depends on SMP
	default "4"

comment "*****System type*****"

config RAM_BASE
	hex "It must be the same with the memory section in your dts"
	default 0x0
endmenu

menu "Power management options"

source "kernel/power/Kconfig"

config ARCH_SUSPEND_POSSIBLE
	bool
	default y
endmenu

source "mm/Kconfig"

source "fs/Kconfig.binfmt"

source "kernel/Kconfig.preempt"

source "net/Kconfig"

source "drivers/Kconfig"

source "fs/Kconfig"

source "arch/csky/Kconfig.debug"

source "security/Kconfig"

source "crypto/Kconfig"

source "lib/Kconfig"
```

## arch/csky/Kconfig.debug
```kconfig
menu "Kernel hacking"

menu "C-SKY Debug Options"
config CSKY_BUILTIN_DTB
	bool "Use kernel builtin dtb"

config CSKY_BUILTIN_DTB_NAME
	string "kernel builtin dtb name"
	depends on CSKY_BUILTIN_DTB

config CSKY_KBUILD_CFLAGS
	string "append to KBUILD_CFLAGS"
endmenu

source "lib/Kconfig.debug"

endmenu
```

## arch/riscv/configs/tinylab32ilp32_defconfig
```kconfig
# CONFIG_LOCALVERSION_AUTO is not set
# CONFIG_CROSS_MEMORY_ATTACH is not set
CONFIG_BLK_DEV_INITRD=y
# CONFIG_RD_GZIP is not set
# CONFIG_RD_BZIP2 is not set
# CONFIG_RD_LZMA is not set
# CONFIG_RD_XZ is not set
# CONFIG_RD_LZO is not set
# CONFIG_RD_LZ4 is not set
# CONFIG_RD_ZSTD is not set
# CONFIG_INITRAMFS_PRESERVE_MTIME is not set
CONFIG_CC_OPTIMIZE_FOR_SIZE=y
# CONFIG_MULTIUSER is not set
# CONFIG_SYSFS_SYSCALL is not set
# CONFIG_FHANDLE is not set
# CONFIG_POSIX_TIMERS is not set
# CONFIG_BUG is not set
# CONFIG_BASE_FULL is not set
# CONFIG_FUTEX is not set
# CONFIG_EPOLL is not set
# CONFIG_SIGNALFD is not set
# CONFIG_TIMERFD is not set
# CONFIG_EVENTFD is not set
# CONFIG_SHMEM is not set
# CONFIG_AIO is not set
# CONFIG_IO_URING is not set
# CONFIG_ADVISE_SYSCALLS is not set
# CONFIG_MEMBARRIER is not set
# CONFIG_KALLSYMS is not set
# CONFIG_RSEQ is not set
CONFIG_EMBEDDED=y
CONFIG_NONPORTABLE=y
CONFIG_ARCH_RV32I=y
CONFIG_CMODEL_MEDANY=y
# CONFIG_RISCV_ISA_SVPBMT is not set
# CONFIG_RISCV_ISA_ZICBOM is not set
# CONFIG_RISCV_ISA_ZICBOZ is not set
# CONFIG_FPU is not set
# CONFIG_SECCOMP is not set
# CONFIG_STACKPROTECTOR is not set
# CONFIG_STRICT_KERNEL_RWX is not set
# CONFIG_BLOCK is not set
# CONFIG_BINFMT_SCRIPT is not set
# CONFIG_COREDUMP is not set
CONFIG_SLUB_TINY=y
# CONFIG_COMPAT_BRK is not set
# CONFIG_COMPACTION is not set
# CONFIG_VM_EVENT_COUNTERS is not set
# CONFIG_SECRETMEM is not set
CONFIG_DEVTMPFS=y
CONFIG_DEVTMPFS_MOUNT=y
# CONFIG_STANDALONE is not set
# CONFIG_PREVENT_FIRMWARE_BUILD is not set
# CONFIG_FW_LOADER is not set
# CONFIG_ALLOW_DEV_COREDUMP is not set
# CONFIG_INPUT is not set
# CONFIG_SERIO is not set
# CONFIG_VT is not set
# CONFIG_UNIX98_PTYS is not set
# CONFIG_LEGACY_PTYS is not set
# CONFIG_LEGACY_TIOCSTI is not set
# CONFIG_LDISC_AUTOLOAD is not set
CONFIG_SERIAL_8250=y
# CONFIG_SERIAL_8250_DEPRECATED_OPTIONS is not set
# CONFIG_SERIAL_8250_16550A_VARIANTS is not set
CONFIG_SERIAL_8250_CONSOLE=y
CONFIG_SERIAL_OF_PLATFORM=y
# CONFIG_HW_RANDOM is not set
# CONFIG_DEVMEM is not set
# CONFIG_HWMON is not set
# CONFIG_USB_SUPPORT is not set
# CONFIG_VIRTIO_MENU is not set
# CONFIG_VHOST_MENU is not set
# CONFIG_IOMMU_SUPPORT is not set
# CONFIG_FILE_LOCKING is not set
# CONFIG_DNOTIFY is not set
# CONFIG_INOTIFY_USER is not set
# CONFIG_PROC_FS is not set
# CONFIG_SYSFS is not set
# CONFIG_EFIVAR_FS is not set
# CONFIG_MISC_FILESYSTEMS is not set
CONFIG_INIT_STACK_NONE=y
# CONFIG_SYMBOLIC_ERRNAME is not set
# CONFIG_DEBUG_MISC is not set
# CONFIG_SECTION_MISMATCH_WARN_ONLY is not set
CONFIG_PANIC_TIMEOUT=1
# CONFIG_FTRACE is not set
# CONFIG_RUNTIME_TESTING_MENU is not set
```

## drivers/mtd/spi-nor/controllers/Kconfig
```kconfig
# SPDX-License-Identifier: GPL-2.0-only
config SPI_HISI_SFC
	tristate "Hisilicon FMC SPI NOR Flash Controller(SFC)"
	depends on ARCH_HISI || COMPILE_TEST
	depends on HAS_IOMEM
	help
	  This enables support for HiSilicon FMC SPI NOR flash controller.

config SPI_NXP_SPIFI
	tristate "NXP SPI Flash Interface (SPIFI)"
	depends on OF && (ARCH_LPC18XX || COMPILE_TEST)
	depends on HAS_IOMEM
	help
	  Enable support for the NXP LPC SPI Flash Interface controller.

	  SPIFI is a specialized controller for connecting serial SPI
	  Flash. Enable this option if you have a device with a SPIFI
	  controller and want to access the Flash as a mtd device.

config SPI_SOPHGO_SPIFMC
	tristate "Sophgo SPI Flash Master Controller (SPIFMC)"
	depends on SOC_SOPHGO || COMPILE_TEST
	depends on HAS_IOMEM
	help
	  Enable support for the Sophgo SPI Flash Master controller.

	  SPIFMC is a master controller to control serial SPI Flash.
	  Enable this option if you have a device with a SPIFMC controller
	  and want to access the Flash as a mtd device.
```

## gx3xxx/Kconfig
```kconfig
# arch/csky/gx3xxx/Kconfig
#
# Copyright (C) 2011, NationaChip Co., Ltd. (www.nationalchp.com) 
#
# Licensed under GPLv2

if GX3XXX

config BOOTPARAM
    bool "Compiled-in Kernel Boot Parameter"
    default y

config BOOTPARAM_STRING
    string "Kernel Boot Parameter"
    default "mem=32m"
    depends on BOOTPARAM

endif
```
